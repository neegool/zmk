## app/boards/shields/nice_view_custom/Kconfig.defconfig
```kconfig
# Copyright (c) 2022 The ZMK Contributors
# SPDX-License-Identifier: MIT

if SHIELD_NICE_VIEW_CUSTOM

config ZMK_DISPLAY
    select LV_FONT_MONTSERRAT_26

config SPI
    default y

config LS0XX_CUSTOM
	default y

config ZMK_WIDGET_WPM_STATUS
    default y if !ZMK_SPLIT || ZMK_SPLIT_ROLE_CENTRAL

config LV_Z_BITS_PER_PIXEL
    default 1

choice LV_COLOR_DEPTH
    default LV_COLOR_DEPTH_1
endchoice

config LV_Z_VDB_SIZE
    default 100

config LV_DPI_DEF
    default 161

config LV_Z_BITS_PER_PIXEL
    default 1

endif
```

## app/module/drivers/display/Kconfig
```kconfig
# Copyright (c) 2021 The ZMK Contributors
# SPDX-License-Identifier: MIT

if DISPLAY

rsource "Kconfig.il0323"
rsource "Kconfig.ls0xx_custom"

endif # DISPLAY
```
