/*
 * Copyright (c) 2022 The ZMK Contributors
 *
 * SPDX-License-Identifier: MIT
 */

&nice_view_spi {
	status = "okay";
	nice_view: ls0xx_custom@0 {
		compatible = "sharp,ls0xx_custom";
		label = "DISPLAY";
		spi-max-frequency = <1000000>;
		reg = <0>;
		width = <160>;
		height = <68>;
	};
};

/ {
    chosen {
        zephyr,display = &nice_view;
    };
};
